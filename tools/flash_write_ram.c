/*
 * flash_write_ram.c — RAM-resident flash programmer for N32WB031
 *
 * Runs entirely from SRAM. OpenOCD loads this ELF to 0x2000B000, sets up
 * a parameter block, loads firmware data to 0x20000000, then resumes
 * execution. The stub uses the SDK's own Qflash binary blob to erase
 * sectors and write pages via the proprietary Qflash controller.
 *
 * RAM layout (set by flash_stub.ld and openocd/flash_n32.tcl):
 *   0x20000000  firmware data  (loaded by OpenOCD, up to 47 KB)
 *   0x2000B800  parameter block (16 bytes, see below)
 *   0x2000B810  this ELF  (.text + .rodata including blob)
 *   0x2000BFFC  initial SP
 *
 * Parameter block at 0x2000B800:
 *   [+0x00]  flash_addr    (uint32_t) — absolute flash address to program
 *   [+0x04]  data_length   (uint32_t) — bytes to write (0 = erase only)
 *   [+0x08]  erase_sectors (uint32_t) — 4 KB sectors to erase (0 = write only)
 *   [+0x0C]  status        (uint32_t) — OUT: 0=success, nonzero=error code
 *
 * Build:
 *   arm-none-eabi-gcc -mcpu=cortex-m0 -mthumb -Os -nostdlib \
 *     -T tools/flash_stub.ld -e main \
 *     -o tools/flash_write_ram.elf tools/flash_write_ram.c
 */

#include <stdint.h>

/* ── Qflash binary blob ─────────────────────────────────────────────────────
 * Verbatim copy of const_qflash_cmd[] from SDK n32wb03x_qflash.c.
 * This is position-independent Thumb code that drives the proprietary
 * Qflash controller. Function entry points (with Thumb bit):
 *   Read  = blob + 0x09   (CMD_FLASH_READ)
 *   Erase = blob + 0xA1   (CMD_FLASH_SE)   — takes relative address
 *   Write = blob + 0x135  (CMD_FLASH_WRITE) — takes relative address, ptr, len
 * "Relative address" = absolute flash address − 0x01000000.
 * -------------------------------------------------------------------------- */
static const uint8_t __attribute__((aligned(4))) _acCMD_BIN[0x324] = {
0x01,0x38,0xfd,0xd1,0x70,0x47,0x00,0x00,0xf0,0xb4,0x03,0x24,0xa4,0x06,0x23,0x6a,
0x5b,0x08,0x5b,0x00,0x23,0x62,0x23,0x6a,0x02,0x25,0x2b,0x43,0x23,0x62,0x23,0x6a,
0x9b,0x07,0xfc,0xd4,0xff,0x23,0x01,0x33,0xa3,0x62,0x65,0x69,0xde,0x1d,0xb5,0x43,
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0x70,0x47,0x00,0x00
};

/* ── Blob function types ─────────────────────────────────────────────────── */
typedef uint32_t (*erase_func_t)(uint32_t rel_addr);
typedef uint32_t (*write_func_t)(uint32_t rel_addr, uint8_t *data, uint32_t len);

#define FLASH_BASE    ((uint32_t)0x01000000)
#define PARAM_BASE    ((volatile uint32_t *)0x2000B800)
#define DATA_BASE     ((uint8_t *)0x20000000)
#define SECTOR_SIZE   ((uint32_t)0x1000)   /* 4 KB erase sector */
#define PAGE_SIZE     ((uint32_t)0x100)    /* 256 B write page  */

/* Forward declaration — called from naked entry via inline asm */
void do_flash(void);

/* ── Entry point ─────────────────────────────────────────────────────────── */
/* Named stub_entry (not main) to avoid compiler warnings about void main.   */
void __attribute__((naked, noreturn)) stub_entry(void)
{
    __asm volatile (
        "ldr r0, =0x2000BFFC \n"  /* SP = top of SRAM - 4, stub is at 0x2000B810 */
        "mov sp, r0          \n"
        "bl  do_flash        \n"
        "bkpt #0             \n"   /* halt → OpenOCD wait_halt returns */
    );
}

/* ── Flash operation ─────────────────────────────────────────────────────── */
void do_flash(void)
{
    volatile uint32_t *params = PARAM_BASE;
    uint32_t flash_addr    = params[0];
    uint32_t data_length   = params[1];
    uint32_t erase_sectors = params[2];
    uint8_t *src           = DATA_BASE;

    /* Function pointers into the Qflash blob (Thumb bit included) */
    erase_func_t erase = (erase_func_t)((uint32_t)_acCMD_BIN + 0xA0 + 1);
    write_func_t write = (write_func_t)((uint32_t)_acCMD_BIN + 0x134 + 1);

    /* Phase 1 — Erase */
    if (erase_sectors > 0) {
        uint32_t rel = flash_addr - FLASH_BASE;
        for (uint32_t i = 0; i < erase_sectors; i++) {
            uint32_t result = erase(rel);
            if (result != 0) {
                params[3] = 0x10000000 | i;   /* error: erase failed at sector i */
                return;
            }
            rel += SECTOR_SIZE;
        }
    }

    /* Phase 2 — Write in 256-byte pages */
    if (data_length > 0) {
        uint32_t rel    = flash_addr - FLASH_BASE;
        uint32_t offset = 0;

        while (offset < data_length) {
            uint32_t chunk = data_length - offset;
            if (chunk > PAGE_SIZE) chunk = PAGE_SIZE;

            uint32_t result = write(rel, src + offset, chunk);
            if (result != 0) {
                params[3] = 0x20000000 | (offset >> 8);  /* error: write failed at page */
                return;
            }
            rel    += PAGE_SIZE;
            offset += PAGE_SIZE;
        }
    }

    params[3] = 0;  /* success */
}
